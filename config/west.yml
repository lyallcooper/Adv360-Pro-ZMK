## config/west.yml
```yaml
manifest:
  remotes:
    - name: zmkfirmware
      url-base: https://github.com/zmkfirmware
    - name: refil
      url-base: https://github.com/refil
    - name: cvcore
      url-base: https://github.com/cvcore
  projects:
    - name: zmk
      remote: cvcore
      revision: cvcore/adv360-z3.2-beta-ble-user-disconnection
      import: app/west.yml
  self:
    path: config
```
